## drivers/lsm9ds1/Kconfig
```kconfig
# Copyright (c) 2020 HAW Hamburg
#
# This file is subject to the terms and conditions of the GNU Lesser
# General Public License v2.1. See the file LICENSE in the top level
# directory for more details.
#

config MODULE_LSM9DS1
    bool
    prompt "LSM9DS1 3D accelerometer/gyroscope/magnetometer" if !(MODULE_SAUL_DEFAULT && HAVE_LSM9DS1)
    default y if (MODULE_SAUL_DEFAULT && HAVE_LSM9DS1)
    depends on HAS_PERIPH_I2C
    depends on TEST_KCONFIG
    select MODULE_PERIPH_I2C
    select MODULE_ZTIMER
    select MODULE_ZTIMER_MSEC

config HAVE_LSM9DS1
    bool
    help
        Indicates that a LSM9DS1 sensor is present.
```
